## config/boards/shields/nilsers42s_choc/Kconfig.defconfig
```kconfig
if SHIELD_NILSERS42S_V2_LEFT

config ZMK_KEYBOARD_NAME
    default "nilsers42s-v2"

endif


if SHIELD_NILSERS42S_V2_LEFT || SHIELD_NILSERS42S_V2_RIGHT

config ZMK_SPLIT
    default y

endif
```

## config/boards/shields/nilsers42s_choc/Kconfig.shield
```kconfig
config SHIELD_NILSERS42S_V2_LEFT
    def_bool $(shields_list_contains, nilsers42s_v2_left)

config SHIELD_NILSERS42S_V2_RIGHT
    def_bool $(shields_list_contains, nilsers42s_v2_right)
```
